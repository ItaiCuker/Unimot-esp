## src/Kconfig.projbuild
```kconfig
menu "Unimot Configuration"
    config UNIMOT_POP
        string "proof of possesion"
        default "unimot"
        help
          Proof of possesion key for provisioning
endmenu
```
